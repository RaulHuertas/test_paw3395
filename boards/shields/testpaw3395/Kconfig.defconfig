## boards/shields/testpaw3395/Kconfig.defconfig
```kconfig
if SHIELD_TESTPAW3395
# Name must be less than 16 characters long!
config ZMK_KEYBOARD_NAME
    default "TestPAW3395"

config ZMK_SPLIT_ROLE_CENTRAL
    default y

config ZMK_POINTING
    default y

config SPI
    default y

config PAW3395
    default y

config INPUT
    default y
#CONFIG_INPUT=y
#
#CONFIG_ZMK_POINTING=y
#CONFIG_PAW3395=y
config LOG_PROCESS_THREAD_STARTUP_DELAY_MS
    default 10000
endif
```

## boards/shields/testpaw3395/Kconfig.shield
```kconfig
# No whitespace after the comma or in your keyboard name!
config SHIELD_TESTPAW3395
    def_bool $(shields_list_contains,testpaw3395)
```
